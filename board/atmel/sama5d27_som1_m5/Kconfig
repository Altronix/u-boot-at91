## board/atmel/sama5d27_som1_m5/Kconfig
```kconfig
if TARGET_SAMA5D27_SOM1_M5

config SYS_BOARD
	default "sama5d27_som1_m5"

config SYS_VENDOR
	default "atmel"

config SYS_SOC
	default "at91"

config SYS_CONFIG_NAME
	default "sama5d27_som1_m5"

config DOUBLE_COPY
	bool "Support for \"Double Copy\" software update"
	default n
	select NAND_BOOT

endif
```
